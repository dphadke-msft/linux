## drivers/crypto/aspeed/Kconfig
```kconfig
config CRYPTO_DEV_ASPEED
	tristate "Support for Aspeed cryptographic engine driver"
	depends on ARCH_ASPEED
	select CRYPTO_ENGINE
	select CRYPTO_SHA1
	select CRYPTO_SHA256
	select CRYPTO_SHA512
	select CRYPTO_HMAC
	select CRYPTO_AES
	select CRYPTO_DES
	select CRYPTO_ECB
	select CRYPTO_CBC
	select CRYPTO_CFB
	select CRYPTO_OFB
	select CRYPTO_CTR
	help
	  Hash and Crypto Engine (HACE) is designed to accelerate the
	  throughput of hash data digest, encryption and decryption.
	  Supported message digest standards -
	  SHA-1, SHA-224, SHA-256, SHA-384, SHA-512.
	  Supported AES/DES symmetric-key encryption and decryption
	  with ECB/CBC/CFB/OFB/CTR modes.

	  Select y here to have support for the cryptographic driver
	  available on Aspeed SoC.

config CRYPTO_DEV_ASPEED_HACE_DEBUG
	bool "Enable HACE debug messages"
	depends on CRYPTO_DEV_ASPEED
	help
	  Print HACE debugging messages if you use this option
	  to ask for those messages.
	  Avoid enabling this option for production build to
	  minimize driver timing.
```
